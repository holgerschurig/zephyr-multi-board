## boards/arm/local/Kconfig.board
```kconfig
# Locally defined board

# Copyright (c) 2024 Holger Schurig
# SPDX-License-Identifier: Apache-2.0

config BOARD_LOCAL
    bool "Locally defined board"
    depends on SOC_STM32F303XC
```

## boards/arm/local/Kconfig.defconfig
```kconfig
# Locally defined board

# Copyright (c) 2024 Holger Schurig
# SPDX-License-Identifier: Apache-2.0

if BOARD_LOCAL

config BOARD
    default "local"

endif
```
